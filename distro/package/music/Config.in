## distro/package/music/Config.in
```kconfig
config BR2_PACKAGE_MUSIC
	bool "music app"
	depends on BR2_PACKAGE_GSTREAMER_ROCKCHIP
	help
	  "music app based on QT5"
```

## distro/package/rkscript/Config.in
```kconfig
config BR2_PACKAGE_RKSCRIPT
	bool "rkscript"
	default y
	help
	  Script used for partition init, usb device and other test script.

config BR2_PACKAGE_RKSCRIPT_UMS
        bool "usb mass storage"
        depends on BR2_PACKAGE_RKSCRIPT
        help
          usb mass storage config

config BR2_PACKAGE_RKSCRIPT_ADBD
        bool "adbd"
        depends on BR2_PACKAGE_RKSCRIPT
        help
          android adbd config
```

## distro/package/rkwifibt/Config.in
```kconfig
config BR2_PACKAGE_RKWIFIBT
	bool "rkwifibt"
	help
	  "wifi chip support"

config BR2_PACKAGE_RKWIFIBT_BTUART
	string "bt uart"
	default "ttyS4"
	depends on BR2_PACKAGE_RKWIFIBT
	help
		tty that bt used
config BR2_PACKAGE_RKWIFIBT_NTP
	bool "ntp"
	depends on BR2_PACKAGE_RKWIFIBT
	help
	  "ntp config"
```

## distro/package/settings/Config.in
```kconfig
config BR2_PACKAGE_SETTINGS
	bool "settings app"
	help
	  "settings app based on QT5"
```

## distro/package/video/Config.in
```kconfig
config BR2_PACKAGE_VIDEO
	bool "video app"
	depends on BR2_PACKAGE_GSTREAMER_ROCKCHIP
	help
	  "video app based on QT5"
```

## distro/package/weston/Config.in
```kconfig
config BR2_PACKAGE_WESTON
	bool "weston"
	help
	  "Weston is the reference implementation of a Wayland compositor"
```
