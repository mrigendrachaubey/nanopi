## distro/package/gallery/Config.in
```kconfig
config BR2_PACKAGE_GALLERY
	bool "gallery app"
	help
	  "gallery app based on QT5"
```

## distro/package/glmark2/Config.in
```kconfig
config BR2_PACKAGE_GLMARK2
	bool "glmark2"
	depends on BR2_PACKAGE_WESTON || BR2_PACKAGE_LIBDRM
	help
	  "a opengles benchmark"
```
