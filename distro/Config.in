## distro/package/libmali/Config.in
```kconfig
config BR2_PACKAGE_LIBMALI
	bool "libmali"
	depends on BR2_PACKAGE_LIBDRM
	help
	  "mali user space library"
```

## distro/package/libmpg123/Config.in
```kconfig
config BR2_PACKAGE_LIBMPG123
	bool "libmpg123"
	help
	  "Fast, free and portable MPEG audio player for Unix. It
          supports MPEG 1.0/2.0 layers 1, 2 and 3."
```

## distro/package/libqgsttools/Config.in
```kconfig
config BR2_PACKAGE_LIBQGSTTOOLS
	bool "libqgsttools-p1"
	help
	  "GStreamer tools for Qt 5 Multimedia module"
```

## distro/package/mpp/Config.in
```kconfig
config BR2_PACKAGE_MPP
	bool "mpp"
	help
	  "Rockchip Multimedia Processing Platform"
```
