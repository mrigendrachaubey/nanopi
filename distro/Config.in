## distro/package/ffmpeg/Config.in
```kconfig
config BR2_PACKAGE_FFMPEG
	bool "ffmpeg"
	help
	  "ffmpeg is a complete, cross-platform solution to record, convert and stream audio and video."

config BR2_PACKAGE_FFMPEG_ALSA
bool "ffmpeg ALSA"
depends on BR2_PACKAGE_FFMPEG
help
  "disable ALSA support [autodetect]"

config BR2_PACKAGE_FFMPEG_APPKIT
bool "ffmpeg Apple AppKit framework"
depends on BR2_PACKAGE_FFMPEG
help
  "disable Apple AppKit framework [autodetect]"

config BR2_PACKAGE_FFMPEG_AVFOUNDATION
bool "ffmpeg Apple AVFoundation framework"
depends on BR2_PACKAGE_FFMPEG
help
  "disable Apple AVFoundation framework [autodetect]"

config BR2_PACKAGE_FFMPEG_AVISYNTH
bool "ffmpeg AviSynth"
depends on BR2_PACKAGE_FFMPEG
help
  "enable reading of AviSynth script files [no]"

config BR2_PACKAGE_FFMPEG_BZLIB
bool "ffmpeg bzlib"
depends on BR2_PACKAGE_FFMPEG
help
  "disable bzlib [autodetect]"

config BR2_PACKAGE_FFMPEG_COREIMAGE
bool "ffmpeg Apple CoreImage framework"
depends on BR2_PACKAGE_FFMPEG
help
  "disable Apple CoreImage framework [autodetect]"

config BR2_PACKAGE_FFMPEG_CHROMAPRINT
bool "ffmpeg fingerprinting"
depends on BR2_PACKAGE_FFMPEG
help
  "enable audio fingerprinting with chromaprint [no]"

config BR2_PACKAGE_FFMPEG_FREI0R
bool "ffmpeg frei0r"
depends on BR2_PACKAGE_FFMPEG
help
  "enable frei0r video filtering [no]"

config BR2_PACKAGE_FFMPEG_GCRYPT
bool "ffmpeg gcrypt"
depends on BR2_PACKAGE_FFMPEG
help
  "enable gcrypt, needed for rtmp(t)e support. if openssl, librtmp or gmp is not used [no]"

config BR2_PACKAGE_FFMPEG_GMP
bool "ffmpeg gmp"
depends on BR2_PACKAGE_FFMPEG
help
  "enable gmp, needed for rtmp(t)e support, if openssl or librtmp is not used [no]"

config BR2_PACKAGE_FFMPEG_GNUTLS
bool "ffmpeg gnutls"
depends on BR2_PACKAGE_FFMPEG
help
  "enable gnutls, needed for https support, if openssl or libtls is not used [no]"

config BR2_PACKAGE_FFMPEG_ICONV
bool "ffmpeg iconv"
depends on BR2_PACKAGE_FFMPEG
help
  "disable iconv [autodetect]"

config BR2_PACKAGE_FFMPEG_JNI
bool "ffmpeg jni"
depends on BR2_PACKAGE_FFMPEG
help
  "enable JNI support [no]"

config BR2_PACKAGE_FFMPEG_LADSPA
bool "ffmpeg ladspa"
depends on BR2_PACKAGE_FFMPEG
help
  "enable LADSPA audio filtering [no]"

config BR2_PACKAGE_FFMPEG_LIBAOM
bool "ffmpeg libaom"
depends on BR2_PACKAGE_FFMPEG
help
  "enable AV1 video encoding/decoding via libaom [no]"

config BR2_PACKAGE_FFMPEG_LIBASS
bool "ffmpeg libass subtitles"
depends on BR2_PACKAGE_FFMPEG
help
  "enable libass subtitles rendering, needed for subtitles and ass filter [no]"

config BR2_PACKAGE_FFMPEG_BLURAY
bool "ffmpeg libbluray"
depends on BR2_PACKAGE_FFMPEG
help
  "enable BluRay reading using libbluray [no]"

config BR2_PACKAGE_FFMPEG_LIBBS2B
bool "ffmpeg libbs2b"
depends on BR2_PACKAGE_FFMPEG
help
  "enable bs2b DSP library [no]"

config BR2_PACKAGE_FFMPEG_LIBCACA
bool "ffmpeg libcaca"
depends on BR2_PACKAGE_FFMPEG
help
  "enable textual display using libcaca [no]"

config BR2_PACKAGE_FFMPEG_LIBCELT
bool "ffmpeg libcelt"
depends on BR2_PACKAGE_FFMPEG
help
  "enable CELT decoding via libcelt [no]"

config BR2_PACKAGE_FFMPEG_LIBCDIO
bool "ffmpeg libcdio"
depends on BR2_PACKAGE_FFMPEG
help
  "enable audio CD grabbing with libcdio [no]"

config BR2_PACKAGE_FFMPEG_LIBCODEC2
bool "ffmpeg libcodec2"
depends on BR2_PACKAGE_FFMPEG
help
  "enable codec2 en/decoding using libcodec2 [no]"

config BR2_PACKAGE_FFMPEG_LIBDC1394
bool "ffmpeg libdc1394"
depends on BR2_PACKAGE_FFMPEG
help
  "enable IIDC-1394 grabbing using libdc1394, and libraw1394 [no]"

config BR2_PACKAGE_FFMPEG_LIBFDK_AAC
bool "ffmpeg libfdk-aac"
depends on BR2_PACKAGE_FFMPEG
help
  "enable AAC de/encoding via libfdk-aac [no]"

config BR2_PACKAGE_FFMPEG_LIBFLITE
bool "ffmpeg libflite"
depends on BR2_PACKAGE_FFMPEG
help
  "enable flite (voice synthesis) support via libflite [no]"

config BR2_PACKAGE_FFMPEG_LIBFONTCONFIG
bool "ffmpeg libfontconfig"
depends on BR2_PACKAGE_FFMPEG
help
  "enable libfontconfig, useful for drawtext filter [no]"

config BR2_PACKAGE_FFMPEG_LIBFREETYPE
bool "ffmpeg libfreetype"
depends on BR2_PACKAGE_FFMPEG
help
  "enable libfreetype, needed for drawtext filter [no]"

config BR2_PACKAGE_FFMPEG_LIBFRIBIDI
bool "ffmpeg libfribidi"
depends on BR2_PACKAGE_FFMPEG
help
  "enable libfribidi, improves drawtext filter [no]"

config BR2_PACKAGE_FFMPEG_LIBGME
bool "ffmpeg libgme"
depends on BR2_PACKAGE_FFMPEG
help
  "enable Game Music Emu via libgme [no]"

config BR2_PACKAGE_FFMPEG_LIBGSM
bool "ffmpeg libgsm"
depends on BR2_PACKAGE_FFMPEG
help
  "enable GSM de/encoding via libgsm [no]"

config BR2_PACKAGE_FFMPEG_LIBIEC61883
bool "ffmpeg libiec61883"
depends on BR2_PACKAGE_FFMPEG
help
  "enable iec61883 via libiec61883 [no]"

config BR2_PACKAGE_FFMPEG_LIBILBC
bool "ffmpeg libilbc"
depends on BR2_PACKAGE_FFMPEG
help
  "enable iLBC de/encoding via libilbc [no]"

config BR2_PACKAGE_FFMPEG_LIBJACK
bool "ffmpeg libjack"
depends on BR2_PACKAGE_FFMPEG
help
  "enable JACK audio sound server [no]"

config BR2_PACKAGE_FFMPEG_LIBKVAZAAR
bool "ffmpeg libkvazaar"
depends on BR2_PACKAGE_FFMPEG
help
  "enable HEVC encoding via libkvazaar [no]"

config BR2_PACKAGE_FFMPEG_LIBMODPLUG
bool "ffmpeg libmodplug"
depends on BR2_PACKAGE_FFMPEG
help
  "enable ModPlug via libmodplug [no]"

config BR2_PACKAGE_FFMPEG_LIBMP3LAME
bool "ffmpeg libmp3lame"
depends on BR2_PACKAGE_FFMPEG
help
  "enable MP3 encoding via libmp3lame [no]"

config BR2_PACKAGE_FFMPEG_LIBOPENCORE_AMRNB
bool "ffmpeg libopencore-amrnb"
depends on BR2_PACKAGE_FFMPEG
help
  "enable AMR-NB de/encoding via libopencore-amrnb [no]"

config BR2_PACKAGE_FFMPEG_LIBOPENCORE_AMRWB
bool "ffmpeg libopencore-amrwb"
depends on BR2_PACKAGE_FFMPEG
help
  "enable AMR-WB decoding via libopencore-amrwb [no]"

config BR2_PACKAGE_FFMPEG_LIBOPENCV
bool "ffmpeg libopencv"
depends on BR2_PACKAGE_FFMPEG
help
  "enable video filtering via libopencv [no]"

config BR2_PACKAGE_FFMPEG_LIBOPENH264
bool "ffmpeg libopenh264"
depends on BR2_PACKAGE_FFMPEG
help
  "enable H.264 encoding via OpenH264 [no]"

config BR2_PACKAGE_FFMPEG_LIBOPENJPEG
bool "ffmpeg libopenjpeg"
depends on BR2_PACKAGE_FFMPEG
help
  "enable JPEG 2000 de/encoding via OpenJPEG [no]"

config BR2_PACKAGE_FFMPEG_LIBOPENMPT
bool "ffmpeg libopenmpt"
depends on BR2_PACKAGE_FFMPEG
help
  "enable decoding tracked files via libopenmpt [no]"

config BR2_PACKAGE_FFMPEG_LIBOPUS
bool "ffmpeg libopus"
depends on BR2_PACKAGE_FFMPEG
help
  "enable Opus de/encoding via libopus [no]"

config BR2_PACKAGE_FFMPEG_LIBPULSE
bool "ffmpeg libpulse"
depends on BR2_PACKAGE_FFMPEG
help
  "enable Pulseaudio input via libpulse [no]"

config BR2_PACKAGE_FFMPEG_LIBRSVG
bool "ffmpeg librsvg"
depends on BR2_PACKAGE_FFMPEG
help
  "enable SVG rasterization via librsvg [no]"

config BR2_PACKAGE_FFMPEG_LIBRUBBERBAND
bool "ffmpeg librubberband"
depends on BR2_PACKAGE_FFMPEG
help
  "enable rubberband needed for rubberband filter [no]"

config BR2_PACKAGE_FFMPEG_LIBRTMP
bool "ffmpeg librtmp"
depends on BR2_PACKAGE_FFMPEG
help
  "enable RTMP[E] support via librtmp [no]"

config BR2_PACKAGE_FFMPEG_LIBSHINE
bool "ffmpeg libshine"
depends on BR2_PACKAGE_FFMPEG
help
  "enable fixed-point MP3 encoding via libshine [no]"

config BR2_PACKAGE_FFMPEG_LIBSMBCLIENT
bool "ffmpeg libsmbclient"
depends on BR2_PACKAGE_FFMPEG
help
  "enable Samba protocol via libsmbclient [no]"

config BR2_PACKAGE_FFMPEG_LIBSNAPPY
bool "ffmpeg libsnappy"
depends on BR2_PACKAGE_FFMPEG
help
  "enable Snappy compression, needed for hap encoding [no]"

config BR2_PACKAGE_FFMPEG_LIBSOXR
bool "ffmpeg libsoxr"
depends on BR2_PACKAGE_FFMPEG
help
  "enable Include libsoxr resampling [no]"

config BR2_PACKAGE_FFMPEG_LIBSPEEX
bool "ffmpeg libspeex"
depends on BR2_PACKAGE_FFMPEG
help
  "enable Speex de/encoding via libspeex [no]"

config BR2_PACKAGE_FFMPEG_LIBSRT
bool "ffmpeg libsrt"
depends on BR2_PACKAGE_FFMPEG
help
  "enable Haivision SRT protocol via libsrt [no]"

config BR2_PACKAGE_FFMPEG_LIBSSH
bool "ffmpeg libssh"
depends on BR2_PACKAGE_FFMPEG
help
  "enable SFTP protocol via libssh [no]"

config BR2_PACKAGE_FFMPEG_LIBTESSERACT
bool "ffmpeg libtesseract"
depends on BR2_PACKAGE_FFMPEG
help
  "enable Tesseract, needed for ocr filter [no]"

config BR2_PACKAGE_FFMPEG_LIBTHEORA
bool "ffmpeg libtheora"
depends on BR2_PACKAGE_FFMPEG
help
  "enable Theora encoding via libtheora [no]"

config BR2_PACKAGE_FFMPEG_LIBTLS
bool "ffmpeg libtls"
depends on BR2_PACKAGE_FFMPEG
help
  "enable LibreSSL (via libtls), needed for https support. if openssl or gnutls is not used [no]"

config BR2_PACKAGE_FFMPEG_LIBTWOLAME
bool "ffmpeg libtwolame"
depends on BR2_PACKAGE_FFMPEG
help
  "enable MP2 encoding via libtwolame [no]"

config BR2_PACKAGE_FFMPEG_LIBV4L2
bool "ffmpeg libv4l2"
depends on BR2_PACKAGE_FFMPEG
help
  "enable libv4l2/v4l-utils [no]"

config BR2_PACKAGE_FFMPEG_LIBVIDSTAB
bool "ffmpeg libvidstab"
depends on BR2_PACKAGE_FFMPEG
help
  "enable video stabilization using vid.stab [no]"

config BR2_PACKAGE_FFMPEG_LIBVMAF
bool "ffmpeg libvmaf"
depends on BR2_PACKAGE_FFMPEG
help
  "enable vmaf filter via libvmaf [no]"

config BR2_PACKAGE_FFMPEG_LIBVO_AMRWBENC
bool "ffmpeg libvo-amrwbenc"
depends on BR2_PACKAGE_FFMPEG
help
  "enable AMR-WB encoding via libvo-amrwbenc [no]"

config BR2_PACKAGE_FFMPEG_LIBVORBIS
bool "ffmpeg libvorbis"
depends on BR2_PACKAGE_FFMPEG
help
  "enable Vorbis en/decoding via libvorbis, native implementation exists [no]"

config BR2_PACKAGE_FFMPEG_LIBVPX
bool "ffmpeg libvpx"
depends on BR2_PACKAGE_FFMPEG
help
  "enable VP8 and VP9 de/encoding via libvpx [no]"

config BR2_PACKAGE_FFMPEG_LIBWAVPACK
bool "ffmpeg libwavpack"
depends on BR2_PACKAGE_FFMPEG
help
  "enable wavpack encoding via libwavpack [no]"

config BR2_PACKAGE_FFMPEG_LIBWEBP
bool "ffmpeg libwebp"
depends on BR2_PACKAGE_FFMPEG
help
  "enable WebP encoding via libwebp [no]"

config BR2_PACKAGE_FFMPEG_LIBX264
bool "ffmpeg libx264"
depends on BR2_PACKAGE_FFMPEG
help
  "enable H.264 encoding via x264 [no]"

config BR2_PACKAGE_FFMPEG_LIBX265
bool "ffmpeg libx265"
depends on BR2_PACKAGE_FFMPEG
help
  "enable HEVC encoding via x265 [no]"

config BR2_PACKAGE_FFMPEG_LIBXAVS
bool "ffmpeg libxavs"
depends on BR2_PACKAGE_FFMPEG
help
  "enable AVS encoding via xavs [no]"

config BR2_PACKAGE_FFMPEG_LIBXCB
bool "ffmpeg libxcb"
depends on BR2_PACKAGE_FFMPEG
help
  "enable X11 grabbing using XCB [autodetect]"

config BR2_PACKAGE_FFMPEG_LIBXCB_SHM
bool "ffmpeg libxcb-shm"
depends on BR2_PACKAGE_FFMPEG
help
  "enable X11 grabbing shm communication [autodetect]"

config BR2_PACKAGE_FFMPEG_LIBXCB_XFIXES
bool "ffmpeg libxcb-xfixes"
depends on BR2_PACKAGE_FFMPEG
help
  "enable X11 grabbing mouse rendering [autodetect]"

config BR2_PACKAGE_FFMPEG_LIBXCB_SHAPE
bool "ffmpeg libxcb-shape"
depends on BR2_PACKAGE_FFMPEG
help
  "enable X11 grabbing shape rendering [autodetect]"

config BR2_PACKAGE_FFMPEG_LIBXVID
bool "ffmpeg libxvid"
depends on BR2_PACKAGE_FFMPEG
help
  "enable Xvid encoding via xvidcore, native MPEG-4/Xvid encoder exists [no]"

config BR2_PACKAGE_FFMPEG_LIBXML2
bool "ffmpeg libxml2"
depends on BR2_PACKAGE_FFMPEG
help
  "enable XML parsing using the C library libxml2 [no]"

config BR2_PACKAGE_FFMPEG_LIBZIMG
bool "ffmpeg libzimg"
depends on BR2_PACKAGE_FFMPEG
help
  "enable z.lib, needed for zscale filter [no]"

config BR2_PACKAGE_FFMPEG_LIBZMQ
bool "ffmpeg libzmq"
depends on BR2_PACKAGE_FFMPEG
help
  "enable message passing via libzmq [no]"

config BR2_PACKAGE_FFMPEG_LIBZVBI
bool "ffmpeg libzvbi"
depends on BR2_PACKAGE_FFMPEG
help
  "enable teletext support via libzvbi [no]"

config BR2_PACKAGE_FFMPEG_LV2
bool "ffmpeg lv2"
depends on BR2_PACKAGE_FFMPEG
help
  "enable LV2 audio filtering [no]"

config BR2_PACKAGE_FFMPEG_LZMA
bool "ffmpeg LZMA"
depends on BR2_PACKAGE_FFMPEG
help
  "disable lzma [autodetect]"

config BR2_PACKAGE_FFMPEG_DECKLINK
bool "ffmpeg decklink"
depends on BR2_PACKAGE_FFMPEG
help
  "enable Blackmagic DeckLink I/O support [no]"

config BR2_PACKAGE_FFMPEG_LIBNDI_NEWTEK
bool "ffmpeg libndi_newtek"
depends on BR2_PACKAGE_FFMPEG
help
  "enable Newteck NDI I/O support [no]"

config BR2_PACKAGE_FFMPEG_MEDIACODEC
bool "ffmpeg mediacodec"
depends on BR2_PACKAGE_FFMPEG
help
  "enable Android MediaCodec support [no]"

config BR2_PACKAGE_FFMPEG_LIBMYSOFA
bool "ffmpeg libmysofa"
depends on BR2_PACKAGE_FFMPEG
help
  "enable libmysofa, needed for sofalizer filter [no]"

config BR2_PACKAGE_FFMPEG_OPENAL
bool "ffmpeg openal"
depends on BR2_PACKAGE_FFMPEG
help
  "enable OpenAL 1.1 capture support [no]"

config BR2_PACKAGE_FFMPEG_OPENCL
bool "ffmpeg opencl"
depends on BR2_PACKAGE_FFMPEG
help
  "enable OpenCL processing [no]"

config BR2_PACKAGE_FFMPEG_OPENGL
bool "ffmpeg opengl"
depends on BR2_PACKAGE_FFMPEG
help
  "enable OpenGL rendering [no]"

config BR2_PACKAGE_FFMPEG_OPENSSL
bool "ffmpeg openssl"
depends on BR2_PACKAGE_FFMPEG
help
  "enable openssl, needed for https support. if gnutls or libtls is not used [no]"

config BR2_PACKAGE_FFMPEG_SNDIO
bool "ffmpeg sndio"
depends on BR2_PACKAGE_FFMPEG
help
  "disable sndio support [autodetect]"

config BR2_PACKAGE_FFMPEG_SCHANNEL
bool "ffmpeg SChannel SSP"
depends on BR2_PACKAGE_FFMPEG
help
  "disable SChannel SSP, needed for TLS support on. Windows if openssl and gnutls are not used [autodetect]"

config BR2_PACKAGE_FFMPEG_SDL2
bool "ffmpeg sdl2"
depends on BR2_PACKAGE_FFMPEG
help
  "disable sdl2 [autodetect]"

config BR2_PACKAGE_FFMPEG_SECURETRANSPORT
bool "ffmpeg Secure Transport"
depends on BR2_PACKAGE_FFMPEG
help
  "disable Secure Transport, needed for TLS support. on OSX if openssl and gnutls are not used [autodetect]"

config BR2_PACKAGE_FFMPEG_XLIB
bool "ffmpeg xlib"
depends on BR2_PACKAGE_FFMPEG
help
  "disable xlib [autodetect]"

config BR2_PACKAGE_FFMPEG_ZLIB
bool "ffmpeg zlib"
depends on BR2_PACKAGE_FFMPEG
help
  "disable zlib [autodetect]"

config BR2_PACKAGE_FFMPEG_AMF
bool "ffmpeg amf"
depends on BR2_PACKAGE_FFMPEG
help
  "disable AMF video encoding code [autodetect]"

config BR2_PACKAGE_FFMPEG_AUDIOTOOLBOX
bool "ffmpeg AudioToolbox"
depends on BR2_PACKAGE_FFMPEG
help
  "disable Apple AudioToolbox code [autodetect]"

config BR2_PACKAGE_FFMPEG_CUDA
bool "ffmpeg cuda"
depends on BR2_PACKAGE_FFMPEG
help
  "enable CUDA features that require the CUDA SDK [no]"

config BR2_PACKAGE_FFMPEG_CUVID
bool "ffmpeg cuvid"
depends on BR2_PACKAGE_FFMPEG
help
  "disable Nvidia CUVID support [autodetect]"

config BR2_PACKAGE_FFMPEG_D3D11VA
bool "ffmpeg d3d11va"
depends on BR2_PACKAGE_FFMPEG
help
  "disable Microsoft Direct3D 11 video acceleration code [autodetect]"

config BR2_PACKAGE_FFMPEG_DXVA2
bool "ffmpeg dxva2"
depends on BR2_PACKAGE_FFMPEG
help
  "disable Microsoft DirectX 9 video acceleration code [autodetect]"

config BR2_PACKAGE_FFMPEG_FFNVCODEC
bool "ffmpeg ffnvcodec"
depends on BR2_PACKAGE_FFMPEG
help
  "disable dynamically linked Nvidia code [autodetect]"

config BR2_PACKAGE_FFMPEG_LIBDRM
bool "ffmpeg libdrm"
depends on BR2_PACKAGE_FFMPEG
help
  "enable DRM code (Linux) [no]"

config BR2_PACKAGE_FFMPEG_LIBMFX
bool "ffmpeg libmfx"
depends on BR2_PACKAGE_FFMPEG
help
  "enable Intel MediaSDK (AKA Quick Sync Video) code via libmfx [no]"

config BR2_PACKAGE_FFMPEG_LIBNPP
bool "ffmpeg libnpp"
depends on BR2_PACKAGE_FFMPEG
help
  "enable Nvidia Performance Primitives-based code [no]"

config BR2_PACKAGE_FFMPEG_MMAL
bool "ffmpeg mmal"
depends on BR2_PACKAGE_FFMPEG
help
  "enable Broadcom Multi-Media Abstraction Layer (Raspberry Pi) via MMAL [no]"

config BR2_PACKAGE_FFMPEG_NVDEC
bool "ffmpeg nvdec"
depends on BR2_PACKAGE_FFMPEG
help
  "disable Nvidia video decoding acceleration (via hwaccel) [autodetect]"

config BR2_PACKAGE_FFMPEG_NVENC
bool "ffmpeg nvenc"
depends on BR2_PACKAGE_FFMPEG
help
  "disable Nvidia video encoding code [autodetect]"

config BR2_PACKAGE_FFMPEG_OMX
bool "ffmpeg omx"
depends on BR2_PACKAGE_FFMPEG
help
  "enable OpenMAX IL code [no]"

config BR2_PACKAGE_FFMPEG_OMX_RPI
bool "ffmpeg omx-rpi"
depends on BR2_PACKAGE_FFMPEG
help
  "enable OpenMAX IL code for Raspberry Pi [no]"

config BR2_PACKAGE_FFMPEG_RKMPP
bool "ffmpeg rkmpp"
depends on BR2_PACKAGE_FFMPEG
help
  "enable Rockchip Media Process Platform code [no]"

config BR2_PACKAGE_FFMPEG_V4L2_M2M
bool "ffmpeg v4l2-m2m"
depends on BR2_PACKAGE_FFMPEG
help
  "disable V4L2 mem2mem code [autodetect]"

config BR2_PACKAGE_FFMPEG_VAAPI
bool "ffmpeg vaapi"
depends on BR2_PACKAGE_FFMPEG
help
  "disable Video Acceleration API (mainly Unix/Intel) code [autodetect]"

config BR2_PACKAGE_FFMPEG_VDPAU
bool "ffmpeg vdpau"
depends on BR2_PACKAGE_FFMPEG
help
  "disable Nvidia Video Decode and Presentation API for Unix code [autodetect]"

config BR2_PACKAGE_FFMPEG_VIDEOTOOLBOX
bool "ffmpeg videotoolbox"
depends on BR2_PACKAGE_FFMPEG
help
  "disable VideoToolbox code [autodetect]"
```
