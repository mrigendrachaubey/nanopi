## distro/Config.in
```kconfig
#

mainmenu "Distro Configuration"

menu "Build options"

config BR2_DEFCONFIG_FROM_ENV
	string
	option env="BR2_DEFCONFIG"

config BR2_DEFCONFIG
	string "Location to save buildroot config"
	default BR2_DEFCONFIG_FROM_ENV if BR2_DEFCONFIG_FROM_ENV != ""
	default "$(CONFIG_DIR)/defconfig"
	help
	  When running 'make savedefconfig', the defconfig file will be
	  saved in this location.

endmenu

source "package/Config.in"
```

## distro/package/Config.in
```kconfig
menu "Target packages"
	source "package/QLauncher/Config.in"
	source "package/alsa-config/Config.in"
	source "package/audioservice/Config.in"
	source "package/busybox/Config.in"
	source "package/camera/Config.in"
	source "package/camera_engine_rkisp/Config.in"
	source "package/ffmpeg/Config.in"
	source "package/gallery/Config.in"
	source "package/glmark2/Config.in"
	source "package/gstreamer/Config.in"
	source "package/gst-plugins-bad/Config.in"
	source "package/gst-plugins-base/Config.in"
	source "package/gst-plugins-good/Config.in"
	source "package/gst-plugins-rockchip/Config.in"
	source "package/gst-plugins-ugly/Config.in"
	source "package/gstreamer-rockchip/Config.in"
        source "package/libdrm/Config.in"
        source "package/libmad/Config.in"
        source "package/libmali/Config.in"
        source "package/libmpg123/Config.in"
	source "package/mpp/Config.in"
	source "package/music/Config.in"
	source "package/rkscript/Config.in"
	source "package/rkwifibt/Config.in"
	source "package/settings/Config.in"
	source "package/video/Config.in"
	source "package/weston/Config.in"
endmenu
```

## distro/package/QLauncher/Config.in
```kconfig
config BR2_PACKAGE_QLAUNCHER
	bool "QLauncher"
	help
	  "QLauncher based on QT5"
```

## distro/package/alsa-config/Config.in
```kconfig
config BR2_PACKAGE_ALSA_CONFIG
	bool "alsa-config"
	help
	  "copy extra alsa configs to /usr/share/alsa/"
```

## distro/package/audioservice/Config.in
```kconfig
config BR2_PACKAGE_AUDIOSERVICE
	bool "audioservice"
	help
	  "audioservice is a background audio player"
```

## distro/package/busybox/Config.in
```kconfig
config BR2_PACKAGE_BUSYBOX
	bool "BusyBox"
	default y
	help
	  The Swiss Army Knife of embedded Linux. It slices, it dices,
	  it makes Julian Fries.

	  http://busybox.net/

	  Most people will answer Y.

if BR2_PACKAGE_BUSYBOX

config BR2_PACKAGE_BUSYBOX_CONFIG
	string "BusyBox configuration file to use?"
	default "package/busybox/busybox.config"
	help
	  Some people may wish to use their own modified BusyBox
	  configuration file, and will specify their config file
	  location with this option.

	  Most people will just use the default BusyBox configuration
	  file.

endif
```
